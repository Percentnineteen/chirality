/*
 * Copyright (c) 2021 The ZMK Contributors
 *
 * SPDX-License-Identifier: MIT
 */

#include <dt-bindings/zmk/keys.h>

/ {
    behaviors {
        /omit-if-no-ref/ sponge_lock: behavior_sponge_lock {
            compatible = "zmk,behavior-sponge-lock";
            #binding-cells = <0>;
            continue-list = <UNDERSCORE SPACE>;
            display-name = "SPONGE_LOCK";
        };
    };
};

