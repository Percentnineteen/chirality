## boards/shields/chirality/Kconfig.defconfig
```kconfig
if SHIELD_CHIRALITY_LEFT

config ZMK_KEYBOARD_NAME
	default "Chirality"

config ZMK_SPLIT_ROLE_CENTRAL
	default y

endif

if SHIELD_CHIRALITY_LEFT || SHIELD_CHIRALITY_RIGHT

config ZMK_SPLIT
	default y

if LVGL

config LVGL_VDB_SIZE
	default 64

config LVGL_DPI
	default 148

config LVGL_BITS_PER_PIXEL
	default 1

choice LVGL_COLOR_DEPTH
	default LVGL_COLOR_DEPTH_1
endchoice

endif # LVGL

endif
```

## boards/shields/chirality_old/Kconfig.shield
```kconfig
# Copyright (c) 2020 Pete Johanson
# SPDX-License-Identifier: MIT

config SHIELD_CHIRALITY_OLD_LEFT
	def_bool $(shields_list_contains,chirality_old_left)

config SHIELD_CHIRALITY_OLD_RIGHT
	def_bool $(shields_list_contains,chirality_old_right)
```

## dts/bindings/behaviors/zmk,behavior-sponge-lock.yaml
```yaml
# Copyright (c) 2021 The ZMK Contributors
# SPDX-License-Identifier: MIT

description: Sponge lock behavior

compatible: "zmk,behavior-sponge-lock"

include: zero_param.yaml

properties:
  continue-list:
    type: array
    required: true
  mods:
    type: int
```
